## arch/arm/mach-hisi/Kconfig
```kconfig
config SECURE_EXTENSION
        bool "security extension support"
        default n
        help
          Include Security Extension.

config ARCH_HISI
	bool "Hisilicon family"
	select ARCH_HAS_CPUFREQ
	select ARCH_REQUIRE_GPIOLIB
	select ARM_AMBA
	select ARM_GIC
	select CLKDEV_LOOKUP
	select COMMON_CLK
	select GENERIC_CLOCKEVENTS
	select HAVE_CLK
	select HAVE_SMP
	select NO_IOPORT
	select PINCTRL
	select PINCTRL_SINGLE
	select ARCH_HAS_OPP
	select ARCH_HAS_PASR
	help
	  Support for Hisilicon Hi36xx/Hi37xx/Hi6620 processor family

config ARCH_KIRIN
	bool "Hisilicon Kirin family"
	help
	  Support for Hisilicon Kirin processor family
if ARCH_HISI
choice
	prompt "Hisilicon processor type"

config ARCH_HI3XXX
	bool "Hisilicon HI3xxx processor Family"
	default n
	help
	  Say 'Y' here if you want to support the Hisilicon HI3XXX Development
	  Board.

config ARCH_HI6XXX
	bool "Hisilicon HI6xxx processor Family"
	default n
	select ARM_CCI
	select CPU_V7
	select ARM_TIMER_SP804
	help
	  Say 'Y' here if you want to support the Hisilicon HI6XXX Development
	  Board.
endchoice

menu "HI3xxx Processor Family"
	depends on ARCH_HI3XXX

config ARCH_HI3630FPGA
	bool "Hisilicon HI3630 FPGA Board"
	default n

	select ARM_CCI
	select CPU_V7
	select ARM_TIMER_SP804
	help
	  Say 'Y' here if you want to support the Hisilicon HI3630 FPGA
	  Development Board.

config ARCH_HI3630EMULATOR
	bool "Hisilicon HI3630 Emulator Board"
	default n

	select ARM_CCI
	select CPU_V7
	select ARM_TIMER_SP804
	help
	  Say 'Y' here if you want to support the Hisilicon HI3630 EMULATOR
	  Development Board.

config ARCH_HI3630
	bool "Hisilicon HI3630 ASIC Board"
	default n

	select ARM_CCI
	select CPU_V7
	select ARM_TIMER_SP804
	help
	  Say 'Y' here if you want to support the Hisilicon HI3630 ASIC
	  Development Board.
endmenu


menu "HI6xxx Processor Family"
	depends on ARCH_HI6XXX

config ARCH_HI6620
	bool "Hisilicon HI6620 ASIC Board"
	default n

	select ARM_CCI
	select CPU_V7
	select ARM_TIMER_SP804
	help
	  Say 'Y' here if you want to support the Hisilicon HI6620 ASIC
	  Development Board.
endmenu

endif


menu "Hisilicon NoC Support"

endmenu

config HI3630_LPM3_IPC
	bool "InterProcessor Communication Support"
	default n
	help
          support Acore communication with LPM3

config HISI_LPM3
	bool "Hisilicon LPM3"
	default n
	help
	  Hi3630 lpm3 watchdog driver

config HISI_LPM3_DEBUG
	depends on HISI_LPM3
	depends on HISI_MAILBOX
	bool "Hisilicon LPM3 DEBUG"
	default n
	help
	  Hi3630 lpm3 debug driver

config HISI_REBOOT_TYPE
	bool "Hisilicon reboot type"
	default n
	help
	  Hi3630 reboot type

config HISI_UDP_BOARDID
	bool "Hisilicon udp board id driver"
	default y
	help
	Hi3630 udp board id driver support

config HISI_ALTER_HARDWARE_NAME
	bool "Hardware name can be set a alternative one"
	default y
	help
	Hardware name can be set a alternative one

config HISI_SR_DEBUG
	bool "hisi suspend-resume debug interface"
	depends on PM
	default n
	help
	suspend-resume debug for hisi platform

config HISI_SR_DEBUG_SLEEP
	bool "hisi suspend-resume debug sleep"
	depends on PM
	default n
	help
	suspend-resume debug sleep for hisi platform

config HISI_BALONG_MODEM
	bool "Hisilicon ap+modem config"
	default n
	help
	Hisilicon ap+modem config support.
config HISI_LPM3_VIEWER
	bool "Hisilicon lpm3 log viewer"
	default n
	help
	Hi3630 lpm3 log viewer driver
```

## drivers/gpu/arm/Kconfig
```kconfig
config MALI_DEVICE
	bool "mali device"
	help

if ARCH_HI6XXX
source "drivers/gpu/arm/mali4_32/Kconfig"
source "drivers/gpu/arm/mali4_64/Kconfig"
endif

if HISI_3635
source "drivers/gpu/arm/r8p0-01dev0/Kconfig"
endif

if ARCH_HI3630
source "drivers/gpu/arm/r8p0-01dev0/Kconfig"
endif
```

## drivers/hisi/Kconfig
```kconfig
config HISILICON_PLATFORM
	bool "Hisilicon platform support"
	default n 
	help
	  Say yes here to support the hisilicon platform

config HISI_BALONG_MODEM_HI3630
	bool "HISI_BALONG_MODEM_HI3630 support"
	default n 
	help
	  Say yes here to support HISI_BALONG_MODEM_HI3630

if HISILICON_PLATFORM

source "drivers/hisi/adc/Kconfig"
source "drivers/hisi/ddrc/Kconfig"
source "drivers/hisi/hifidsp/Kconfig"
source "drivers/hisi/hi3630dsp/Kconfig"
source "drivers/hisi/hi6xxx/Kconfig"
source "drivers/hisi/efuse/Kconfig"
source "drivers/hisi/keymaster/Kconfig"
source "drivers/hisi/mntn/Kconfig"
source "drivers/hisi/ipc_hi6xxx/Kconfig"
source "drivers/hisi/hifi_mailbox/Kconfig"
source "drivers/hisi/modem_hi6xxx/Kconfig"
source "drivers/hisi/modem_hi3xxx/Kconfig"
source "drivers/hisi/modem_hi3630/Kconfig"
source "drivers/hisi/mailbox/Kconfig"
source "drivers/hisi/mutex_service/Kconfig"
source "drivers/hisi/noc/Kconfig"
source "drivers/hisi/pm/Kconfig"
source "drivers/hisi/rdr/Kconfig"
source "drivers/hisi/socp/Kconfig"
source "drivers/hisi/tele_mntn/Kconfig"
source "drivers/hisi/mcushell/Kconfig"
source "drivers/hisi/hi3xxx/Kconfig"
source "drivers/hisi/axi/Kconfig"
source "drivers/hisi/hi6421_spk/Kconfig"
source "drivers/hisi/hi6402_mbhc/Kconfig"
source "drivers/hisi/hi6402dsp/Kconfig"
source "drivers/hisi/pm_common/Kconfig"
source "drivers/hisi/misc/Kconfig"
source "drivers/hisi/hmpthresholds/Kconfig"
source "drivers/hisi/memory_dump/Kconfig"
source "drivers/hisi/perfhub/Kconfig"
endif #HISILICON_PLATFORM

if HISI_BALONG_MODEM_HI3XXX
source "drivers/hisi/efuse/Kconfig"
endif
if HISI_BALONG_MODEM_HI3630
source "drivers/hisi/efuse/Kconfig"
endif
```

## drivers/hisi/hmpthresholds/Kconfig
```kconfig
#
# Huawei Set hmp thresholds policy
#

comment "set hmp thresholds policy"
config HISI_HMPTH_SET
	bool "Huawei Set hmp thresholds policy"
	depends on SCHED_HMP
	default n
	help
	  This module provides interfaces for user and kernel to set hmp threshold policy.

config HISI_HMPTH_OPEN
        bool "Enable touch boost hmp thresholds policy"
        depends on HISI_HMPTH_SET
        default n
        help
          Enable touch boost hmp threshold policy.
```

## drivers/hisi/mntn/Kconfig
```kconfig
config HISILICON_PLATFORM_MAINTAIN
	bool "Hisilicon platform maintain module support"
	default n
	help
	  Say yes here to support the hisilicon platform maintain module 

config HISILICON_PLATFORM_HISI_EASYSHELL
	bool "Support HiSilicon Hi6XXX Easy Shell"
	default n
	help
	  This driver supports HiSilicon HiXXX SOC,
	  including easy shell, etc.

config HISI_LOWMEM_DBG
	bool "Hisilicon Low Memory Killer debug"
	default n
	help
	  print processes info when lmk happen per several seconds
```

## drivers/hisi/modem_hi3630/Kconfig
```kconfig
menu "Hisi Modem"	

config BALONG_OAM_PS	
	tristate "support tlmsp tlps gumsp gups taf"	
	default n	
	help	
	   tlmsp tlps gumsp gups taf acore image	

source "drivers/hisi/modem_hi3630/drv/Kconfig"
endmenu	
```

## drivers/huawei_platform/Kconfig
```kconfig
source "drivers/huawei_platform/camera_legacy/Kconfig"
source "drivers/huawei_platform/connectivity/Kconfig"
source "drivers/huawei_platform/dsm/Kconfig"

config SENSORHUB_FEATURE_SUPPORT
	bool "Huawei sensorhub support, for onetrack"
	default n
	help
	Say yes here to support the huawei platform


menu "huawei linux device driver support"
source "drivers/huawei_platform/sensor/Kconfig"
source "drivers/huawei_platform/inputhub/kirin920/Kconfig"
source "drivers/huawei_platform/inputhub/kirin930/Kconfig"
source "drivers/huawei_platform/touthscreen/Kconfig"
source "drivers/huawei_platform/irda/Kconfig"
source "drivers/huawei_platform/log/Kconfig"
source "drivers/huawei_platform/nfc/Kconfig"
source "drivers/huawei_platform/usb/Kconfig"
source "drivers/huawei_platform/ext_modem/Kconfig"
source "drivers/huawei_platform/storage/Kconfig"
source "drivers/huawei_platform/chipverification/Kconfig"
source "drivers/huawei_platform/chr/Kconfig"
source "drivers/huawei_platform/immersion/Kconfig"
source "drivers/huawei_platform/tsif/Kconfig"
endmenu

source "drivers/huawei_platform/audio/Kconfig"
source "drivers/huawei_platform/antenna_fpga/Kconfig"

source "drivers/huawei_platform/power/Kconfig"

source "drivers/huawei_platform/tuners/Kconfig"
source "drivers/huawei_platform/antenna_board_match/Kconfig"
```

## drivers/huawei_platform/antenna_board_match/Kconfig
```kconfig
source "drivers/huawei_platform/antenna_board_match/antenna_board_adc_detect/Kconfig"
```

## drivers/huawei_platform/antenna_board_match/antenna_board_adc_detect/Kconfig
```kconfig
config ANTENNA_BOARD_ADC_DETECT
     bool "antenna_board_adc_detect support"
	 default n
```

## drivers/huawei_platform/audio/Kconfig
```kconfig
source "drivers/huawei_platform/audio/max98925/Kconfig"
source "drivers/huawei_platform/audio/speakerID/Kconfig"
source "drivers/huawei_platform/audio/anc_hs/Kconfig"
source "drivers/huawei_platform/audio/tfa9895/Kconfig"
source "drivers/huawei_platform/audio/earpiece_pa/Kconfig"
source "drivers/huawei_platform/audio/dts_eagle/Kconfig"
source "drivers/huawei_platform/audio/tpa2028_spk_l/Kconfig"
source "drivers/huawei_platform/audio/tpa2028_spk_r/Kconfig"
source "drivers/huawei_platform/audio/ad45257/Kconfig"
```

## drivers/huawei_platform/audio/ad45257/Kconfig
```kconfig
config AD45257
    tristate "AD45257 Driver"
	default n
	help
		Say Y to enable AD45257 PA Support
```

## drivers/huawei_platform/audio/dts_eagle/Kconfig
```kconfig
config DTS_EAGLE
	tristate "DTS Eagle driver"
	default n
	help
	  DTS Eagle module.
```

## drivers/huawei_platform/audio/tpa2028_spk_l/Kconfig
```kconfig
config TPA2028_SPK_L
    tristate "TPA2028 Driver For Speaker Left"
	default n
	help
		Say Y to enable TPA2028 PA Support For Speaker Left
```

## drivers/huawei_platform/dsm/Kconfig
```kconfig
#
# huawei device state monitor configuration
#

config HUAWEI_DSM
	bool "huawei dsm"
	default n
	help
	  If you say yes here you get support for huawei touchscreen.
#/* BEGIN PN:DTS2014081103718 , Modified by d00168349, 2014/08/11 */
config HUAWEI_SDCARD_VOLD
	bool "huawei sdcard vold"
	default y
	help
	  If you say yes here you get support for huawei vold radar.
#/* END PN:DTS2014081103718 , Modified by d00168349, 2014/08/11 */
```

## drivers/huawei_platform/immersion/Kconfig
```kconfig
config IMMERSION
    tristate "immersion"
	default n
	help
	    If you say yes here you get support for immersion.
```

## drivers/huawei_platform/inputhub/kirin920/Kconfig
```kconfig
menuconfig INPUTHUB
	tristate "InputHub feature support"
	help
	  Say Y here to enable input hub feature support. This allows
	  mcu to manage all sensors.

config IOM3_RECOVERY
	bool "iom3 recovery feature support"
	default y

	help
	  Say 'Y' here if you want to support the cmdline parse
```

## drivers/huawei_platform/power/Kconfig
```kconfig
source "drivers/huawei_platform/power/charger/Kconfig"
source "drivers/huawei_platform/power/hw_kstate/Kconfig"
source "drivers/huawei_platform/power/ate/Kconfig"
source "drivers/huawei_platform/power/bastet/Kconfig"
source "drivers/huawei_platform/power/smpl/Kconfig"
source "drivers/huawei_platform/power/cpu_buck/Kconfig"
source "drivers/huawei_platform/power/cpu_buck/lp8754/Kconfig"
source "drivers/huawei_platform/power/msgnotify/Kconfig"
```

## drivers/huawei_platform/touthscreen/panel/Kconfig
```kconfig
#
# huawei touchscreen driver configuration
#

config SYNAPTICS_TS
	bool "synaptics touchscreen"
	default n
	help
	  If you say yes here you get support for synaptics touchscreen.
config SYNAPTICS_LCD_TYPE
	bool "synaptics touchscreen"
	default n
	help
	  If you say yes here you get support for synaptics touchscreen.
config CYPRESS_TS
	bool "cypress touchscreen"
	default n
	help
	  If you say yes here you get support for cypress touchscreen.
config WACOM_TS
	bool "wacom touchscreen"
	default n
	help
	  If you say yes here you get support for wacom touchscreen.
config HIDEEP_TS
	bool "hideep crimson touchscreen"
	default n
	help
	  If you say yes here you get support for hideep touchscreen.
config HI3630_TS_FW_BUILD
	bool "K3V3 FW"
	default y
	help
	  If you say yes here you build FW in HI3630.
config HI3635_TS_FW_BUILD
	bool "K3V3PLUS FW"
	default y
	help
	  If you say yes here you build FW in HI3635.
config HI6220_TS_FW_BUILD
	bool "HI6220 FW"
	default y
	help
	  If you say yes here you build FW in HI6210.
```

## drivers/huawei_platform/tuners/Kconfig
```kconfig
config MEDIA_TUNER_MN8855X
	tristate "Panasonic mm_tuner driver support"
	help
	  This module adds support for wireless adapters based on
	  Panasonic MN8855x chipset.
	  If you choose to build a module, it'll be called mm_tuner. Say Y if
	  unsure.

config MEDIA_TUNER_MN8855X_DEBUG
    bool "Panasonic MN8855x Debug message mode"
	depends on MEDIA_TUNER_MN8855X
	default n
	help
	  MN8855x driver debug message mode. Say Y when you want to debug.
```
